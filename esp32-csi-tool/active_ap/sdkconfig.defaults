## esp32-csi-tool/active_sta/main/Kconfig.projbuild
```kconfig
menu "ESP32 CSI Tool Config"

    config WIFI_CHANNEL
        int "WiFi Channel"
        default 6
        help
            Select the WiFi channel of the AP. In North America, valid channels are {1,2,3,...,10,11}.

    config ESP_WIFI_SSID
        string "WiFi SSID"
        default "myssid"
        help
            SSID (network name) for the example to connect to.

    config ESP_WIFI_PASSWORD
        string "WiFi Password"
        default "mypassword"
        help
            WiFi password (WPA or WPA2) for the example to use.
            Not used when WPA2-Enterprise is enabled below.

    config ESP_WIFI_ENTERPRISE
        bool "WPA2-Enterprise login (eduroam, PEAP/MSCHAPv2)"
        default "n"
        help
            Use 802.1X instead of the shared password. SSID should be
            "eduroam". The identity/username/password can also come from
            main/eap_credentials.h, which stays out of sdkconfig.

    config ESP_EAP_IDENTITY
        depends on ESP_WIFI_ENTERPRISE
        string "EAP outer identity"
        default ""
        help
            Sent in the clear before the TLS tunnel. Often the same as the
            username, or anonymous@your.institution.

    config ESP_EAP_USERNAME
        depends on ESP_WIFI_ENTERPRISE
        string "EAP username"
        default ""
        help
            The inner (tunneled) username, usually user@institution.edu.

    config ESP_EAP_PASSWORD
        depends on ESP_WIFI_ENTERPRISE
        string "EAP password"
        default ""
        help
            The eduroam password. Stored in sdkconfig in plain text; use
            main/eap_credentials.h instead if that bothers you.

    config PACKET_RATE
        int "NTP queries per second"
        default "20"
        help
            How many SNTP requests the socket task sends each second. Each
            query (and its reply) is a frame the radio sees, so this sets the
            floor on CSI sample rate. Keep it low: these go to a public NTP
            server, and 1-5 Hz is plenty of traffic for CSI while still being
            a polite neighbour. Minimum value: 1, Maximum value: 1000.

    config SHOULD_COLLECT_CSI
        bool "Should this ESP32 collect and print CSI data?"
        default "n"
        help
            Allowing only a single ESP32 to collect CSI will likely increase the sampling frequency of your experiments.

    config SHOULD_COLLECT_ONLY_LLTF
        depends on SHOULD_COLLECT_CSI
        bool "(Advanced users only) Should we only collect LLTF?"
        default "y"
        help
            Each CSI frame can contain CSI either calculated through
            (1) legacy long training field (LLTF),
            (2) high throughput LTF (HT-LTF) and/or
            (3) space-time block code HT-LTF (STBC-HT-LTF).
            However, not all CSI frames have HT-LTF or STBC-HT-LTF while all CSI frame have LLTF.
            For beginners collecting only LLTF is the best option while advanced users can handle issues such as
            (1) HT-LTF or STBC-HT-LTF being missing, and
            (2) possible decreases in sampling rate due to serial connection saturation.
            [Advanced Users]: I cannot always help with these advanced issues,
            but if you have ideas on improvements to these issues please share!

    config SEND_CSI_TO_SERIAL
        depends on SHOULD_COLLECT_CSI
        bool "Send CSI data to Serial"
        default "y"
        help
            Sending data through serial (to a computer) can take time and buffer space.
            If you are storing to an SD card, it may be useful to deselect this option.

    config SEND_CSI_TO_SD
        depends on SHOULD_COLLECT_CSI
        bool "Send CSI data to SD"
        default "n"
        help
            Sending data to an SD card can take time and buffer space.
            If your ESP32 does not have an SD card, there is no reason to use this feature.
            If you do though, the program will be recognize this and not attempt writing to the SD card.
endmenu
```
